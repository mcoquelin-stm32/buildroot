## configs/stm32_minimal_defconfig
```kconfig
BR2_arm=y
BR2_cortex_m3=y
BR2_ARM_INSTRUCTIONS_THUMB2=y
BR2_STRIP_none=y
BR2_TOOLCHAIN_EXTERNAL=y
BR2_TOOLCHAIN_EXTERNAL_CUSTOM=y
BR2_TOOLCHAIN_EXTERNAL_PATH="/opt/OSELAS.Toolchain-2014.12.1/arm-cortexm3-uclinuxeabi/gcc-4.9.2-uclibc-0.9.33.2-binutils-2.24-kernel-3.16-sanitized/"
BR2_TOOLCHAIN_EXTERNAL_CUSTOM_PREFIX="arm-cortexm3-uclinuxeabi"
BR2_TOOLCHAIN_EXTERNAL_GCC_4_9=y
BR2_TOOLCHAIN_EXTERNAL_HEADERS_3_16=y
# BR2_TOOLCHAIN_EXTERNAL_HAS_THREADS is not set
BR2_ROOTFS_DEVICE_CREATION_DYNAMIC_MDEV=y
BR2_TARGET_ROOTFS_CPIO=y
```
